## framework/hiacejs-framework/Config.in
```kconfig
source "framework/hiacejs-framework/jerryscript/Config.in"
source "framework/hiacejs-framework/bounds_checking_function/Config.in"
source "framework/hiacejs-framework/hiacejs/Config.in"
```

## framework/hiacejs-framework/bounds_checking_function/Config.in
```kconfig
config BR2_PACKAGE_BOUNDS_CHECKING_FUNCTION
	bool "bounds_checking_function (56 KB)"
    default y
	help
      C11 Annex K (Bounds-checking interfaces)
```

## framework/hiacejs-framework/jerryscript/Config.in
```kconfig
config BR2_PACKAGE_JERRYSCRIPT
	bool "JerryScript (412 KB)"
    default y
	help
      https://jerryscript.net/
```

## framework/hiacejs-runtime/Config.in
```kconfig
source "framework/hiacejs-runtime/jerryscript/Config.in"
source "framework/hiacejs-runtime/bounds_checking_function/Config.in"
source "framework/hiacejs-runtime/hiacejs/Config.in"
```

## framework/hiwebkit-framework/Config.in
```kconfig
source "framework/hiwebkit-framework/hiwebkit/Config.in"
source "framework/hiwebkit-framework/hiviewrenderer/Config.in"
```

## framework/hiwebkit-framework/hiviewrenderer/Config.in
```kconfig
config BR2_PACKAGE_HIVIEWRENDERER
	bool "hiViewRenderer (112 KB)"
	depends on BR2_PACKAGE_HIWEBKIT
	help
	  hiView Renderer
	  https://hybridos.fmsoft.cn/
```

## framework/hiwebkit-runtime/Config.in
```kconfig
source "framework/hiwebkit-runtime/hiwebkit/Config.in"
source "framework/hiwebkit-runtime/hiviewrenderer/Config.in"
```

## package/bounds_checking_function/Config.in
```kconfig
config BR2_PACKAGE_BOUNDS_CHECKING_FUNCTION
	bool "bounds_checking_function"
	help
      C11 Annex K (Bounds-checking interfaces)
```

## package/chipmunk/Config.in
```kconfig
config BR2_PACKAGE_CHIPMUNK
	bool "chipmunk"
	help
	  Chipmunk2D is a simple, lightweight, fast and portable 2D
	  rigid body physics library written in C.

	  http://chipmunk-physics.net/
```

## package/glibc/Config.in
```kconfig
if BR2_TOOLCHAIN_BUILDROOT_GLIBC

comment "Glibc Options"

config BR2_PACKAGE_GLIBC
	bool
	default y
	select BR2_PACKAGE_LINUX_HEADERS
	select BR2_TOOLCHAIN_HAS_SSP if BR2_PACKAGE_HOST_BINUTILS_SUPPORTS_CFI
	help
	  https://www.gnu.org/software/libc/

if BR2_PACKAGE_GLIBC
choice
    prompt "glibc Version"
    default BR2_PACKAGE_GLIBC_2_31
    help
      Select the version of glibc you wish to use.

config BR2_PACKAGE_GLIBC_2_25
    bool "glibc 2.25"

config BR2_PACKAGE_GLIBC_2_29
    bool "glibc 2.29"

config BR2_PACKAGE_GLIBC_2_31
    bool "glibc 2.31"

endchoice
endif


config BR2_PACKAGE_GLIBC_UTILS
	bool "Install glibc utilities"
	help
	  Enabling this option will compile and install the getconf,
	  ldconfig, ldd and locale glibc utilities for the target.

endif # BR2_TOOLCHAIN_BUILDROOT_GLIBC
```

## package/hibox/Config.in
```kconfig
config BR2_PACKAGE_HIBOX
	bool "hiBox (132 KB)"
	help
	  The libubox derivative for HybridOS
	  https://hybridos.fmsoft.cn/
```

## package/hicairo/Config.in
```kconfig
config BR2_PACKAGE_HICAIRO
	bool "hiCairo (752 KB)"
	select BR2_PACKAGE_PIXMAN
	select BR2_PACKAGE_FONTCONFIG
	select BR2_PACKAGE_MINIGUI
	help
	  The Cairo Derivative for HybridOS.

	  https://github.com/FMSoftCN/hicairo

	  Cairo is a 2D graphics library with support for multiple
	  output devices. Currently supported output targets include
	  the X Window System, Win32, image buffers, and PostScript,
	  PDF, and SVG file output. Experimental backends include
	  OpenGL (through glitz), Quartz, and XCB.

	  http://cairographics.org/

if BR2_PACKAGE_HICAIRO

config BR2_PACKAGE_HICAIRO_PS
	bool "postscript support"
	select BR2_PACKAGE_ZLIB
	select BR2_PACKAGE_HICAIRO_PDF

config BR2_PACKAGE_HICAIRO_PDF
	bool "pdf support"
	select BR2_PACKAGE_ZLIB

config BR2_PACKAGE_HICAIRO_PNG
	bool "png support"
	select BR2_PACKAGE_LIBPNG
	select BR2_PACKAGE_ZLIB

config BR2_PACKAGE_HICAIRO_SCRIPT
	bool "script support"
	select BR2_PACKAGE_HICAIRO_PNG

config BR2_PACKAGE_HICAIRO_SVG
	bool "svg support"
	select BR2_PACKAGE_HICAIRO_PNG
	select BR2_PACKAGE_HICAIRO_PDF

config BR2_PACKAGE_HICAIRO_TEE
	bool "tee support"

config BR2_PACKAGE_HICAIRO_XML
	bool "xml support"
	select BR2_PACKAGE_HICAIRO_PNG

endif
```

## package/hirsvg/Config.in
```kconfig
config BR2_PACKAGE_LIBRSVG
	bool "hiRsvg (librsvg derivative for hybridos)"
	depends on BR2_USE_WCHAR # glib2
	depends on BR2_TOOLCHAIN_HAS_THREADS # glib2
	depends on BR2_USE_MMU # glib2
	depends on BR2_INSTALL_LIBSTDCPP # pango
	depends on BR2_TOOLCHAIN_HAS_SYNC_4 # pango -> harfbuzz
	depends on BR2_TOOLCHAIN_GCC_AT_LEAST_4_8 # pango -> harfbuzz
	select BR2_PACKAGE_MINIGUI
	select BR2_PACKAGE_HICAIRO
	select BR2_PACKAGE_LIBCROCO
	select BR2_PACKAGE_LIBGLIB2
	select BR2_PACKAGE_LIBXML2
	select BR2_PACKAGE_PANGO
	help
	  The Librsvg Derivative for HybridOS
	  https://hybridos.fmsoft.cn

	  The rsvg library is an efficient renderer for Scalable
	  Vector Graphics (SVG) pictures.

	  https://wiki.gnome.org/Projects/LibRsvg

comment "hirsvg needs a toolchain w/ wchar, threads, C++, gcc >= 4.8"
	depends on BR2_USE_MMU
	depends on BR2_TOOLCHAIN_HAS_SYNC_4
	depends on !BR2_USE_WCHAR || !BR2_TOOLCHAIN_HAS_THREADS || \
		!BR2_TOOLCHAIN_GCC_AT_LEAST_4_8 || \
		!BR2_INSTALL_LIBSTDCPP
```

## package/hishell/Config.in
```kconfig
config BR2_PACKAGE_HISHELL
	bool "hiShell"
	select BR2_PACKAGE_HYBRIDOS_HIACEJS_RUNTIME
	select BR2_PACKAGE_HYBRIDOS_HIWEBKIT_RUNTIME
	help
      Hybridos shell
      https://hybridos.fmsoft.cn/
```

## package/hisvg/Config.in
```kconfig
config BR2_PACKAGE_HISVG
	bool "hiSVG (188 KB)"
	depends on BR2_USE_WCHAR # glib2
	depends on BR2_TOOLCHAIN_HAS_THREADS # glib2
	depends on BR2_USE_MMU # glib2
	select BR2_PACKAGE_LIBGLIB2
	select BR2_PACKAGE_LIBXML2
	select BR2_PACKAGE_FREETYPE
	select BR2_PACKAGE_MINIGUI
	select BR2_PACKAGE_HICAIRO
	select BR2_PACKAGE_HIDOMLAYOUT
	help
	  hiSVG is a high performance SVG rendering library. 
	  It is derived form librsvg of GNOME Project.

	  https://gitlab.fmsoft.cn/hybridos/hisvg
```

## package/hiviewrenderer/Config.in
```kconfig
config BR2_PACKAGE_HIVIEWRENDERER
	bool "hiViewRenderer"
	select BR2_PACKAGE_HIWEBKIT
	help
	  hiView Renderer
	  https://hybridos.fmsoft.cn/
```

## package/hybridos-base/Config.in
```kconfig
source "package/hybridos-base/minigui/Config.in"
source "package/hybridos-base/minigui-res/Config.in"
source "package/hybridos-base/mgplus/Config.in"
source "package/hybridos-base/mgeff/Config.in"
source "package/hybridos-base/mgncs/Config.in"
source "package/hybridos-base/mgncs4touch/Config.in"
source "package/hybridos-base/hidrmdrivers/Config.in"
source "package/hybridos-base/hicairo/Config.in"
source "package/hybridos-base/hibox/Config.in"
source "package/hybridos-base/hibus/Config.in"
source "package/hybridos-base/hidomlayout/Config.in"
source "package/hybridos-base/hisvg/Config.in"
```

## package/hybridos-base/hidrmdrivers/Config.in
```kconfig
config BR2_PACKAGE_HIDRMDRIVERS
	bool "hiDRMDrivers"
	select BR2_PACKAGE_MINIGUI
	select BR2_PACKAGE_LIBDRM
	help
      The DRM Drivers for MiniGUI/HybridOS
```

## package/hybridos-base/mgeff/Config.in
```kconfig
config BR2_PACKAGE_MGEFF
	bool "mGEff (40 KB)"
    default y
	select BR2_PACKAGE_MINIGUI
	select BR2_PACKAGE_MGPLUS
	help
          http://www.minigui.org
```

## package/hybridos-base/mgncs/Config.in
```kconfig
config BR2_PACKAGE_MGNCS
	bool "mGNCS (104 KB)"
	select BR2_PACKAGE_MINIGUI
	select BR2_PACKAGE_MGPLUS
	select BR2_PACKAGE_LIBXML2
	select BR2_PACKAGE_SQLITE
	help
          http://www.minigui.org
```

## package/hybridos-base/mgutils/Config.in
```kconfig
config BR2_PACKAGE_MGUTILS
	bool "mGUtils (104 KB)"
    default y
	select BR2_PACKAGE_MINIGUI
	help
          http://www.minigui.org
```

## package/hybridos-base/minigui-res/Config.in
```kconfig
config BR2_PACKAGE_MINIGUI_RES
	bool "MiniGUI Resource (8.7 MB)"
    default y
	help
          http://www.minigui.org


if BR2_PACKAGE_MINIGUI_RES

config BR2_PACKAGE_MINIGUI_RES_IEKIE_FONTS
    bool "iekie founts"
    default y

config BR2_PACKAGE_MINIGUI_RES_ADOBE_FONTS
    bool "adobe founts"

endif
```

## package/hybridos-base/minigui/Config.in
```kconfig
config BR2_PACKAGE_MINIGUI
	bool "MiniGUI (2.9 MB)"
    default y
	select BR2_PACKAGE_JPEG
	select BR2_PACKAGE_LIBPNG
	select BR2_PACKAGE_FREETYPE
    select BR2_PACKAGE_HARFBUZZ
    select BR2_PACKAGE_PIXMAN
    select BR2_PACKAGE_LIBDRM
    select BR2_PACKAGE_MINIGUI_RES
	help
          http://www.minigui.org


if BR2_PACKAGE_MINIGUI
choice
    prompt "target board name"
    default BR2_PACKAGE_MINIGUI_TARGET_NAME_UNKNOW
    help
      Select the version of glibc you wish to use.

config BR2_PACKAGE_MINIGUI_TARGET_NAME_UNKNOW
    bool "unknown"

config BR2_PACKAGE_MINIGUI_TARGET_NAME_R818
    bool "r818"

endchoice
endif
```

## package/hybridos-hiacejs-runtime/Config.in
```kconfig
config BR2_PACKAGE_HYBRIDOS_HIACEJS_RUNTIME
	bool "HyBridOS hiACEJS Runtime"
    select BR2_PACKAGE_HYBRIDOS_MINIGUI
    select BR2_PACKAGE_HYBRIDOS_MGPLUS
    select BR2_PACKAGE_HYBRIDOS_MGEFF
    select BR2_PACKAGE_HIDRMDRIVERS
    select BR2_PACKAGE_HICAIRO
    select BR2_PACKAGE_HIBOX
    select BR2_PACKAGE_HIBUS
	help
	  HyBridOS hiACEJS Runtime (hiAceJSKit)

if BR2_PACKAGE_HYBRIDOS_HIACEJS_RUNTIME
source "package/hybridos-hiacejs-runtime/jerryscript/Config.in"
source "package/hybridos-hiacejs-runtime/bounds_checking_function/Config.in"
source "package/hybridos-hiacejs-runtime/hiacejs/Config.in"
endif
```

## package/hybridos-hiacejs-runtime/bounds_checking_function/Config.in
```kconfig
config BR2_PACKAGE_BOUNDS_CHECKING_FUNCTION
	bool "bounds_checking_function"
    default y
	help
      C11 Annex K (Bounds-checking interfaces)
```
