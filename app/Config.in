## app/Config.in
```kconfig
# 

menu "App"

menu "System"
	source "app/system/Config.in"
endmenu
menu "User"
	source "app/user/Config.in"
endmenu

endmenu # App
```

## app/system/hishell/Config.in
```kconfig
config BR2_PACKAGE_HISHELL
	bool "hiShell (3.3 MB)"
	depends on  BR2_PACKAGE_HIWEBKIT
	depends on  BR2_PACKAGE_HIACEJS
	help
      Hybridos shell
      https://hybridos.fmsoft.cn/
```

## app/system/inetd/Config.in
```kconfig
config BR2_PACKAGE_INETD
	bool "inetd (252 KB)"
	select BR2_PACKAGE_HIBOX
	select BR2_PACKAGE_HIBUS
	help
      The inetd runner
```

## app/system/settings/Config.in
```kconfig
config BR2_PACKAGE_SETTINGS
	bool "settings (252 KB)"
	select BR2_PACKAGE_HIBOX
	select BR2_PACKAGE_HIBUS
	help
      The settings app with inetd runner
```

## app/user/Config.in
```kconfig
# 

source "app/user/hishell/Config.in"
source "app/user/hybridos-lite-demo/Config.in"
```

## configs/hybridos_defconfig
```kconfig
BR2_aarch64=y
# BR2_COMPILER_PARANOID_UNSAFE_PATH is not set
BR2_TOOLCHAIN_BUILDROOT_GLIBC=y
BR2_KERNEL_HEADERS_4_9=y
BR2_GCC_VERSION_9_X=y
BR2_TOOLCHAIN_BUILDROOT_CXX=y
BR2_ROOTFS_DEVICE_CREATION_DYNAMIC_EUDEV=y
BR2_PACKAGE_HIVIEWRENDERER=y
BR2_PACKAGE_GDB=y
BR2_PACKAGE_LIBINPUT=y
BR2_PACKAGE_WPA_SUPPLICANT=y
BR2_PACKAGE_WPA_SUPPLICANT_AP_SUPPORT=y
BR2_PACKAGE_WPA_SUPPLICANT_WIFI_DISPLAY=y
BR2_PACKAGE_WPA_SUPPLICANT_CLI=y
BR2_PACKAGE_WPA_SUPPLICANT_WPA_CLIENT_SO=y
BR2_PACKAGE_WPA_SUPPLICANT_PASSPHRASE=y
BR2_PACKAGE_ANDROID_TOOLS=y
```

## configs/hybridos_lite_defconfig
```kconfig
BR2_aarch64=y
# BR2_COMPILER_PARANOID_UNSAFE_PATH is not set
BR2_TOOLCHAIN_BUILDROOT_GLIBC=y
BR2_KERNEL_HEADERS_4_9=y
BR2_GCC_VERSION_9_X=y
BR2_TOOLCHAIN_BUILDROOT_CXX=y
BR2_ROOTFS_DEVICE_CREATION_DYNAMIC_EUDEV=y
BR2_FRAMEWORK_HIACEJS=y
BR2_PACKAGE_GDB=y
BR2_PACKAGE_LIBGCRYPT=y
BR2_PACKAGE_LIBSECRET=y
BR2_PACKAGE_ATK=y
BR2_PACKAGE_OPENJPEG=y
BR2_PACKAGE_WEBP=y
BR2_PACKAGE_WEBP_DEMUX=y
BR2_PACKAGE_WOFF2=y
BR2_PACKAGE_LIBINPUT=y
BR2_PACKAGE_LIBXSLT=y
BR2_PACKAGE_LIBSOUP=y
BR2_PACKAGE_LIBTASN1=y
BR2_PACKAGE_ENCHANT=y
```

## configs/px30_hybridos_defconfig
```kconfig
BR2_TARGET_NAME_px30=y
BR2_aarch64=y
BR2_cortex_a35=y
# BR2_COMPILER_PARANOID_UNSAFE_PATH is not set
BR2_TOOLCHAIN_BUILDROOT_GLIBC=y
BR2_KERNEL_HEADERS_4_9=y
BR2_PACKAGE_GLIBC_2_29=y
BR2_GCC_VERSION_7_X=y
BR2_TOOLCHAIN_BUILDROOT_CXX=y
BR2_ROOTFS_DEVICE_CREATION_DYNAMIC_EUDEV=y
BR2_PACKAGE_HIVIEWRENDERER=y
BR2_PACKAGE_SETTINGS=y
BR2_PACKAGE_HISHELL=y
BR2_PACKAGE_GDB=y
BR2_PACKAGE_GNUTLS=y
BR2_PACKAGE_GNUTLS_OPENSSL=y
BR2_PACKAGE_LIBINPUT=y
BR2_PACKAGE_GLIB_NETWORKING=y
```

## configs/r818_hybridos_defconfig
```kconfig
BR2_TARGET_NAME_r818=y
BR2_aarch64=y
# BR2_COMPILER_PARANOID_UNSAFE_PATH is not set
BR2_TOOLCHAIN_BUILDROOT_GLIBC=y
BR2_KERNEL_HEADERS_4_9=y
BR2_PACKAGE_GLIBC_2_25=y
BR2_BINUTILS_VERSION_2_28_X=y
BR2_GCC_VERSION_7_X=y
BR2_TOOLCHAIN_BUILDROOT_CXX=y
BR2_ROOTFS_DEVICE_CREATION_DYNAMIC_EUDEV=y
BR2_PACKAGE_HIVIEWRENDERER=y
BR2_PACKAGE_SETTINGS=y
BR2_PACKAGE_HISHELL=y
BR2_PACKAGE_GDB=y
BR2_PACKAGE_LIBINPUT=y
```

## configs/r818_hybridos_lite_defconfig
```kconfig
BR2_aarch64=y
# BR2_COMPILER_PARANOID_UNSAFE_PATH is not set
BR2_ENDIAN="LITTLE"

BR2_TOOLCHAIN=y
BR2_TOOLCHAIN_USES_GLIBC=y
BR2_TOOLCHAIN_BUILDROOT=y
BR2_TOOLCHAIN_BUILDROOT_VENDOR="buildroot"
BR2_TOOLCHAIN_BUILDROOT_GLIBC=y
BR2_TOOLCHAIN_BUILDROOT_LIBC="glibc"
BR2_TOOLCHAIN_BUILDROOT_CXX=y

BR2_GCC_TARGET_ABI="lp64"
BR2_GCC_TARGET_CPU="cortex-a53"
BR2_GCC_VERSION_7_X=y
BR2_GCC_SUPPORTS_DLANG=y
BR2_GCC_VERSION="7.5.0"

BR2_PACKAGE_GLIBC_2_25=y

BR2_KERNEL_HEADERS_4_9=y

BR2_BINUTILS_VERSION_2_28_X=y
BR2_BINUTILS_VERSION="2.28.1"
BR2_BINUTILS_EXTRA_CONFIG_OPTIONS=""

BR2_ROOTFS_DEVICE_CREATION_DYNAMIC_EUDEV=y

BR2_PACKAGE_HYBRIDOS_LITE=y
BR2_PACKAGE_LIBINPUT=y
BR2_PACKAGE_WPA_SUPPLICANT=y
BR2_PACKAGE_WPA_SUPPLICANT_AP_SUPPORT=y
BR2_PACKAGE_WPA_SUPPLICANT_WIFI_DISPLAY=y
BR2_PACKAGE_WPA_SUPPLICANT_CLI=y
BR2_PACKAGE_WPA_SUPPLICANT_WPA_CLIENT_SO=y
BR2_PACKAGE_WPA_SUPPLICANT_PASSPHRASE=y
BR2_PACKAGE_ANDROID_TOOLS=y
```

## configs/raspberrypi4_64_hybridos_defconfig
```kconfig
BR2_aarch64=y
BR2_cortex_a72=y
BR2_ARM_FPU_VFPV4=y
# BR2_COMPILER_PARANOID_UNSAFE_PATH is not set
BR2_TOOLCHAIN_BUILDROOT_GLIBC=y
BR2_KERNEL_HEADERS_5_4=y
BR2_TOOLCHAIN_BUILDROOT_CXX=y
BR2_SYSTEM_DHCP="eth0"
BR2_ROOTFS_OVERLAY="board/raspberrypi/rootfs_overlay"
BR2_ROOTFS_POST_BUILD_SCRIPT="board/raspberrypi4-64/post-build.sh"
BR2_ROOTFS_POST_IMAGE_SCRIPT="board/raspberrypi4-64/post-image.sh"
BR2_ROOTFS_POST_SCRIPT_ARGS="--add-miniuart-bt-overlay --aarch64"
BR2_LINUX_KERNEL=y
BR2_LINUX_KERNEL_CUSTOM_TARBALL=y
BR2_LINUX_KERNEL_CUSTOM_TARBALL_LOCATION="$(call github,raspberrypi,linux,rpi-5.4.y)/linux-rpi-5.4.y.tar.gz"
BR2_LINUX_KERNEL_DEFCONFIG="bcm2711"
BR2_LINUX_KERNEL_DTS_SUPPORT=y
BR2_LINUX_KERNEL_INTREE_DTS_NAME="broadcom/bcm2711-rpi-4-b"
BR2_LINUX_KERNEL_NEEDS_HOST_OPENSSL=y
BR2_PACKAGE_MINIGUI_RES=y
BR2_PACKAGE_MGUTILS=y
BR2_PACKAGE_MGEFF=y
BR2_PACKAGE_HIWEBKIT_HTTPS=y
BR2_PACKAGE_HISHELL=y
BR2_PACKAGE_HIVIEWRENDERER=y
BR2_PACKAGE_INETD=y
BR2_PACKAGE_HIDRMDRIVERS=y
BR2_PACKAGE_RPI_BT_FIRMWARE=y
BR2_PACKAGE_RPI_FIRMWARE=y
BR2_PACKAGE_RPI_FIRMWARE_VARIANT_PI4=y
BR2_PACKAGE_RPI_WIFI_FIRMWARE=y
BR2_PACKAGE_DHCPCD=y
BR2_PACKAGE_DHCPDUMP=y
BR2_PACKAGE_ETHTOOL=y
BR2_PACKAGE_IW=y
BR2_PACKAGE_IWD=y
BR2_PACKAGE_OPENSSH=y
BR2_PACKAGE_PHYTOOL=y
BR2_PACKAGE_WIRELESS_TOOLS=y
BR2_PACKAGE_WPA_SUPPLICANT=y
BR2_PACKAGE_WPA_SUPPLICANT_AP_SUPPORT=y
BR2_PACKAGE_WPA_SUPPLICANT_WIFI_DISPLAY=y
BR2_PACKAGE_WPA_SUPPLICANT_MESH_NETWORKING=y
BR2_PACKAGE_WPA_SUPPLICANT_AUTOSCAN=y
BR2_PACKAGE_WPA_SUPPLICANT_EAP=y
BR2_PACKAGE_WPA_SUPPLICANT_HOTSPOT=y
BR2_PACKAGE_WPA_SUPPLICANT_DEBUG_SYSLOG=y
BR2_PACKAGE_WPA_SUPPLICANT_WPS=y
BR2_PACKAGE_WPA_SUPPLICANT_WPA3=y
BR2_PACKAGE_WPA_SUPPLICANT_CLI=y
BR2_PACKAGE_WPA_SUPPLICANT_WPA_CLIENT_SO=y
BR2_PACKAGE_WPA_SUPPLICANT_PASSPHRASE=y
BR2_PACKAGE_WPA_SUPPLICANT_DBUS=y
BR2_PACKAGE_WPA_SUPPLICANT_DBUS_INTROSPECTION=y
BR2_PACKAGE_UTIL_LINUX_MOUNT=y
BR2_PACKAGE_UTIL_LINUX_RFKILL=y
BR2_TARGET_ROOTFS_EXT2=y
BR2_TARGET_ROOTFS_EXT2_4=y
BR2_TARGET_ROOTFS_EXT2_SIZE="384M"
# BR2_TARGET_ROOTFS_TAR is not set
BR2_PACKAGE_HOST_DOSFSTOOLS=y
BR2_PACKAGE_HOST_GENIMAGE=y
BR2_PACKAGE_HOST_MTOOLS=y
```

## framework/Config.in
```kconfig
# 

config BR2_PACKAGE_HIWEBKIT_ARCH_SUPPORTS
	bool
	# ARM needs BLX, so v5t+, BE completely untested so disabled
	default y if BR2_arm && !BR2_ARM_CPU_ARMV4
	default y if BR2_aarch64 || BR2_aarch64_be
	default y if BR2_i386 || BR2_x86_64
	# Disabled on MIPS big endian due to sigbus
	default y if BR2_mipsel || BR2_mips64el
	# Disabled on PowerPC pending runtime testing
	# Disabled on SuperH because of segfault
	depends on BR2_USE_MMU # libglib2
	depends on BR2_TOOLCHAIN_HAS_SYNC_4
	depends on BR2_PACKAGE_LIBGPG_ERROR_ARCH_SUPPORTS # libgcrypt

menu "App Framework"

choice
    prompt "App mode"
    default BR2_APPMODE_MULTI_APP
    help
      Select the version of glibc you wish to use.

config BR2_APPMODE_SINGLE_APP
    bool "Single App mode"

config BR2_APPMODE_MULTI_APP
    bool "Multi-App mode"

endchoice

menu "Fonts"

comment "Chinese Fonts"
config BR2_FONTS_CHINESE_IEKIE_SANS_SERIF_HEI_MEDIUM
    bool "iekie SansSerifHei Chinese Medium (13 MB)"
    default y
    select BR2_PACKAGE_MINIGUI_RES

config R2_FONTS_CHINESE_ADOBE_SOURCE_HAN_SANS_REGULAR
    bool "adobe SourceHanSans Regular (20 MB)"
    select BR2_PACKAGE_MINIGUI_RES

comment "English Fonts"
config BR2_FONTS_ENGLISH_IEKIE_SANS_SERIF_HEI_MEDIUM
    bool "iekie SansSerifHei Latin Medium (48 KB)"
    default y
    select BR2_PACKAGE_MINIGUI_RES

config BR2_FONTS_ENGLISH_IEKIE_SANS_SERIF_HEI_LIGHT
    bool "iekie SansSerifHei Latin Light (48 KB)"
    default y
    select BR2_PACKAGE_MINIGUI_RES

endmenu # Fonts

menu "Base Libraries"
    source "framework/base/Config.in"
endmenu

menu "Runtime"
comment "hiWebKit Runtime needs a glibc toolchain w/ C++, gcc >= 7"
	depends on BR2_PACKAGE_HIWEBKIT_ARCH_SUPPORTS
	depends on !BR2_INSTALL_LIBSTDCPP || \
		!BR2_TOOLCHAIN_USES_GLIBC || \
		!BR2_TOOLCHAIN_GCC_AT_LEAST_7
	depends on BR2_USE_MMU

config BR2_RUNTIME_HIWEBKIT
    bool "hiWebKit Runtime"
    default y
	depends on BR2_INSTALL_LIBSTDCPP
	depends on BR2_TOOLCHAIN_GCC_AT_LEAST_7
	depends on BR2_TOOLCHAIN_USES_GLIBC
	depends on BR2_PACKAGE_HIWEBKIT_ARCH_SUPPORTS
    select BR2_PACKAGE_MINIGUI
    select BR2_PACKAGE_MINIGUI_RES
    select BR2_PACKAGE_MGPLUS
    select BR2_PACKAGE_MGEFF
    select BR2_PACKAGE_HIDRMDRIVERS
    select BR2_PACKAGE_HICAIRO
    select BR2_PACKAGE_HIBOX
    select BR2_PACKAGE_HIBUS
    select BR2_PACKAGE_HIDOMLAYOUT
    select BR2_PACKAGE_HISVG
    select BR2_PACKAGE_HIWEBKIT

if BR2_RUNTIME_HIWEBKIT
    source "framework/hiwebkit-runtime/Config.in"
endif

config BR2_RUNTIME_HIACEJS
    bool "hiAceJS Runtime"
    default y
    select BR2_PACKAGE_MINIGUI
    select BR2_PACKAGE_MINIGUI_RES
    select BR2_PACKAGE_MGPLUS
    select BR2_PACKAGE_MGEFF
    select BR2_PACKAGE_HIDRMDRIVERS
    select BR2_PACKAGE_HICAIRO
    select BR2_PACKAGE_HIBOX
    select BR2_PACKAGE_HIBUS
    select BR2_PACKAGE_HIDOMLAYOUT
    select BR2_PACKAGE_HISVG
    select BR2_PACKAGE_BOUNDS_CHECKING_FUNCTION
    select BR2_PACKAGE_JERRYSCRIPT
    select BR2_PACKAGE_HIACEJS

if BR2_RUNTIME_HIACEJS
    source "framework/hiacejs-runtime/Config.in"
endif

config BR2_RUNTIME_MGNCS_BASED_C
    bool "mGNCS-based C Runtime"
    select BR2_PACKAGE_MINIGUI
    select BR2_PACKAGE_MINIGUI_RES
    select BR2_PACKAGE_MGPLUS
    select BR2_PACKAGE_MGEFF
    select BR2_PACKAGE_MGNCS
    select BR2_PACKAGE_MGNCS4TOUCH
    select BR2_PACKAGE_HIDRMDRIVERS
    select BR2_PACKAGE_HICAIRO
    select BR2_PACKAGE_HIBOX
    select BR2_PACKAGE_HIBUS
    select BR2_PACKAGE_HIDOMLAYOUT
    select BR2_PACKAGE_HISVG

config BR2_RUNTIME_BASIC_C
    bool "Basic MiniGUI C Runtime"
    select BR2_PACKAGE_MINIGUI
    select BR2_PACKAGE_MINIGUI_RES
    select BR2_PACKAGE_MGPLUS
    select BR2_PACKAGE_MGEFF
    select BR2_PACKAGE_HIDRMDRIVERS
    select BR2_PACKAGE_HICAIRO
    select BR2_PACKAGE_HIBOX
    select BR2_PACKAGE_HIBUS
    select BR2_PACKAGE_HIDOMLAYOUT
    select BR2_PACKAGE_HISVG

endmenu # runtime

endmenu # App Framework
```

## framework/base/Config.in
```kconfig
source "framework/base/minigui/Config.in"
source "framework/base/minigui-res/Config.in"
source "framework/base/mgplus/Config.in"
source "framework/base/mgeff/Config.in"
source "framework/base/mgncs/Config.in"
source "framework/base/mgncs4touch/Config.in"
source "framework/base/hidrmdrivers/Config.in"
source "framework/base/hicairo/Config.in"
source "framework/base/hibox/Config.in"
source "framework/base/hibus/Config.in"
source "framework/base/hidomlayout/Config.in"
source "framework/base/hisvg/Config.in"
```

## framework/base/hibox/Config.in
```kconfig
config BR2_PACKAGE_HIBOX
	bool "hiBox (132 KB)"
    default y
	help
	  The libubox derivative for HybridOS
	  https://hybridos.fmsoft.cn/
```

## framework/base/hibus/Config.in
```kconfig
config BR2_PACKAGE_HIBUS
	bool "hiBus (48 KB)"
	select BR2_PACKAGE_HIBOX
	select BR2_PACKAGE_OPENSSL
	select BR2_PACKAGE_OPENSSL_FORCE_LIBOPENSSL
	select BR2_PACKAGE_LIBGLIB2
	help
	  The data bus (the daemon, the command line, and the library 
	  for clients) for the device side of HybridOS.
	  https://hybridos.fmsoft.cn/

if BR2_PACKAGE_HIBUS && BR2_APPMODE_MULTI_APP
config BR2_PACKAGE_HIBUS_BUILD_APP_AUTH
	bool "build app auth"
    default n
endif
```

## framework/base/hicairo/Config.in
```kconfig
config BR2_FRAMEWORK_BASE_HICAIRO
	bool "hiCairo (752 KB)"
    default y
	select BR2_PACKAGE_PIXMAN
	select BR2_PACKAGE_FONTCONFIG
	select BR2_PACKAGE_MINIGUI
	help
	  The Cairo Derivative for HybridOS.

	  https://github.com/FMSoftCN/hicairo

	  Cairo is a 2D graphics library with support for multiple
	  output devices. Currently supported output targets include
	  the X Window System, Win32, image buffers, and PostScript,
	  PDF, and SVG file output. Experimental backends include
	  OpenGL (through glitz), Quartz, and XCB.

	  http://cairographics.org/
```

## framework/base/hidomlayout/Config.in
```kconfig
config BR2_PACKAGE_HIDOMLAYOUT
	bool "hiDomLayout (576 KB)"
	select BR2_PACKAGE_LIBGLIB2
	help
	  hiDOMLayout is a library to maintain a DOM tree, 
	  lay out and stylize the DOM nodes by using CSS (Cascaded Style Sheets).
	  https://gitlab.fmsoft.cn/hybridos/hidomlayout
```

## framework/base/hidrmdrivers/Config.in
```kconfig
config BR2_PACKAGE_HIDRMDRIVERS
	bool "hiDRMDrivers (8 KB)"
	select BR2_PACKAGE_MINIGUI
	select BR2_PACKAGE_LIBDRM
	help
      The DRM Drivers for MiniGUI/HybridOS
```

## framework/base/mgeff/Config.in
```kconfig
config BR2_PACKAGE_MGEFF
	bool "mGEff (92 KB)"
	select BR2_PACKAGE_MINIGUI
	select BR2_PACKAGE_MGPLUS
	help
          http://www.minigui.org
```

## framework/base/mgncs/Config.in
```kconfig
config BR2_FRAMEWORK_BASE_MGNCS
	bool "mGNCS (1.8 MB)"
	select BR2_PACKAGE_MINIGUI
	select BR2_PACKAGE_MGPLUS
	select BR2_PACKAGE_LIBXML2
	select BR2_PACKAGE_SQLITE
	help
          http://www.minigui.org
```

## framework/base/mgncs4touch/Config.in
```kconfig
config BR2_PACKAGE_MGNCS4TOUCH
	bool "mGNCS4Touch (228 KB)"
	select BR2_PACKAGE_MINIGUI
	select BR2_PACKAGE_MGPLUS
	select BR2_PACKAGE_LIBXML2
	select BR2_PACKAGE_SQLITE
	select BR2_PACKAGE_MGEFF
	select BR2_PACKAGE_MGNCS
	select BR2_PACKAGE_CHIPMUNK
	help
          http://www.minigui.org
```

## framework/base/mgplus/Config.in
```kconfig
config BR2_PACKAGE_MGPLUS
	bool "mGPlus (788 KB)"
	select BR2_PACKAGE_MINIGUI
	help
          http://www.minigui.org
```

## framework/base/minigui-res/Config.in
```kconfig
config BR2_PACKAGE_MINIGUI_RES
	bool "MiniGUI Resource"
	help
          http://www.minigui.org
```

## framework/base/minigui/Config.in
```kconfig
config BR2_PACKAGE_MINIGUI
	bool "MiniGUI (2.9 MB)"
	select BR2_PACKAGE_JPEG
	select BR2_PACKAGE_LIBPNG
	select BR2_PACKAGE_FREETYPE
    select BR2_PACKAGE_HARFBUZZ
    select BR2_PACKAGE_PIXMAN
    select BR2_PACKAGE_LIBDRM
    select BR2_PACKAGE_MINIGUI_RES
	help
          http://www.minigui.org

if BR2_PACKAGE_MINIGUI
choice
    prompt "Runmode"
    default BR2_PACKAGE_MINIGUI_RUNMODE_PROCS
    help
      Select the MiniGUI runmode.

config BR2_PACKAGE_MINIGUI_RUNMODE_PROCS
    bool "procs"

config BR2_PACKAGE_MINIGUI_RUNMODE_THS
    bool "ths"

config BR2_PACKAGE_MINIGUI_RUNMODE_SA
    bool "sa"

endchoice

endif
```
