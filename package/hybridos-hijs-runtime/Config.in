## package/hybridos-hijs-runtime/Config.in
```kconfig
config BR2_PACKAGE_HYBRIDOS_HIJS_RUNTIME
	bool "HyBridOS hiJS Runtime"
    select BR2_PACKAGE_HYBRIDOS_BASE
	help
	  HyBridOS hiJS Runtime (hiJSKit)

if BR2_PACKAGE_HYBRIDOS_HIJS_RUNTIME
source "package/hybridos-hijs-runtime/jerryscript/Config.in"
source "package/hybridos-hijs-runtime/bounds_checking_function/Config.in"
source "package/hybridos-hijs-runtime/hiacejs/Config.in"
endif
```

## package/hybridos-hijs-runtime/hiacejs/Config.in
```kconfig
config BR2_PACKAGE_HIACEJS
	bool "hiAceJS"
    default y
	select BR2_PACKAGE_JPEG
	select BR2_PACKAGE_LIBPNG
	select BR2_PACKAGE_FREETYPE
	select BR2_PACKAGE_JERRYSCRIPT
	select BR2_PACKAGE_BOUNDS_CHECKING_FUNCTION
	select BR2_PACKAGE_MBEDTLS
	select BR2_PACKAGE_MINIGUI
	help
      The OpenHarmony ACE JS Derivative for HybridOS
      https://hybridos.fmsoft.cn/
```

## package/hybridos-hijs-runtime/jerryscript/Config.in
```kconfig
config BR2_PACKAGE_JERRYSCRIPT
	bool "JerryScript"
    default y
	help
      https://jerryscript.net/
```

## package/hybridos-hiweb-runtime/Config.in
```kconfig
config BR2_PACKAGE_HYBRIDOS_HIWEB_RUNTIME
	bool "HyBridOS hiWeb Runtime"
    select BR2_PACKAGE_HYBRIDOS_BASE
	help
	  HyBridOS hiWeb Runtime (hiWebKit)

if BR2_PACKAGE_HYBRIDOS_HIWEB_RUNTIME
source "package/hybridos-hiweb-runtime/libproxy/Config.in"
source "package/hybridos-hiweb-runtime/hiwebkit/Config.in"
endif
```

## package/hybridos-hiwebkit-runtime/Config.in
```kconfig
config BR2_PACKAGE_HYBRIDOS_HIWEBKIT_RUNTIME
	bool "hiWebKit Frameworks"
    select BR2_PACKAGE_MINIGUI
    select BR2_PACKAGE_MGPLUS
    select BR2_PACKAGE_MGEFF
    select BR2_PACKAGE_HIDRMDRIVERS
    select BR2_PACKAGE_HICAIRO
    select BR2_PACKAGE_HIBOX
    select BR2_PACKAGE_HIBUS
	help
	  HyBridOS hiWebKit Runtime

if BR2_PACKAGE_HYBRIDOS_HIWEBKIT_RUNTIME
source "package/hybridos-hiwebkit-runtime/libproxy/Config.in"
source "package/hybridos-hiwebkit-runtime/hiwebkit/Config.in"
source "package/hybridos-hiwebkit-runtime/hiviewrenderer/Config.in"
endif
```

## package/hybridos-hiwebkit-runtime/hiviewrenderer/Config.in
```kconfig
config BR2_PACKAGE_HIVIEWRENDERER
	bool "hiViewRenderer (112 KB)"
	select BR2_PACKAGE_HIWEBKIT
	help
	  hiView Renderer
	  https://hybridos.fmsoft.cn/
```

## package/hybridos-hiwebkit-runtime/libproxy/Config.in
```kconfig
config BR2_PACKAGE_LIBPROXY
	bool "libproxy (92 KB)"
    default y
	help
      libproxy
```

## package/hybridos-lite-demo/Config.in
```kconfig
config BR2_PACKAGE_HYBRIDOS_LITE_DEMO
	bool "HybridOS lite demo (556 KB)"
    select BR2_PACKAGE_MINIGUI
    select BR2_PACKAGE_MGPLUS
    select BR2_PACKAGE_MGEFF
    select BR2_PACKAGE_HIDRMDRIVERS
    select BR2_PACKAGE_HICAIRO
    select BR2_PACKAGE_HIBOX
    select BR2_PACKAGE_HIBUS
    select BR2_PACKAGE_HIDOMLAYOUT
    select BR2_PACKAGE_HISVG
	select BR2_PACKAGE_LIBGLIB2
	help
      The sample codes are for HybridOS Lite version, 
      mginit and some samples are inclusive. 
      It illustrates how to build an entire project, which runs in HybridOS Lite.
	  https://gitlab.fmsoft.cn/hybridos/hybridos-lite
```

## package/hybridos-lite/Config.in
```kconfig
config BR2_PACKAGE_HYBRIDOS_LITE
	bool "HyBridOS Lite"
    select BR2_PACKAGE_MINIGUI
    select BR2_PACKAGE_MGPLUS
    select BR2_PACKAGE_MGEFF
    select BR2_PACKAGE_HIDRMDRIVERS
    select BR2_PACKAGE_HICAIRO
    select BR2_PACKAGE_HIBOX
    select BR2_PACKAGE_HIBUS
    select BR2_PACKAGE_HIDOMLAYOUT
    select BR2_PACKAGE_HISVG
    select BR2_PACKAGE_INETD
    select BR2_PACKAGE_INETD
    select BR2_PACKAGE_HYBRIDOS_LITE_DEMO
	help
	  HyBridOS
```

## package/hybridos/Config.in
```kconfig
config BR2_PACKAGE_HYBRIDOS
	bool "HyBridOS"
    select BR2_PACKAGE_MINIGUI
    select BR2_PACKAGE_MGPLUS
    select BR2_PACKAGE_MGEFF
    select BR2_PACKAGE_MGNCS
    select BR2_PACKAGE_MGNCS4TOUCH
    select BR2_PACKAGE_HIDRMDRIVERS
    select BR2_PACKAGE_HICAIRO
    select BR2_PACKAGE_HIBOX
    select BR2_PACKAGE_HIBUS
    select BR2_PACKAGE_HIDOMLAYOUT
    select BR2_PACKAGE_HISVG
    select BR2_PACKAGE_HYBRIDOS_HIWEBKIT_RUNTIME
    select BR2_PACKAGE_HYBRIDOS_HIACEJS_RUNTIME
    select BR2_PACKAGE_INETD
    select BR2_PACKAGE_HISHELL
	help
	  HyBridOS
```

## package/inetd/Config.in
```kconfig
config BR2_PACKAGE_INETD
	bool "inetd"
	select BR2_PACKAGE_HIBOX
	select BR2_PACKAGE_HIBUS
	help
      The inetd runner
```

## package/jerryscript/Config.in
```kconfig
config BR2_PACKAGE_JERRYSCRIPT
	bool "JerryScript"
	help
      https://jerryscript.net/
```

## package/mgeff/Config.in
```kconfig
config BR2_PACKAGE_MGEFF
	bool "mGEff (40 KB)"
	select BR2_PACKAGE_MINIGUI
	help
          http://www.minigui.org
```

## package/mgplus/Config.in
```kconfig
config BR2_PACKAGE_MGPLUS
	bool "mGPlus"
	select BR2_PACKAGE_MINIGUI
	help
          http://www.minigui.org
```

## package/mgutils/Config.in
```kconfig
config BR2_PACKAGE_MGUTILS
	bool "mGUtils (104 KB)"
	select BR2_PACKAGE_MINIGUI
	help
          http://www.minigui.org
```

## package/minigui-res/Config.in
```kconfig
config BR2_PACKAGE_MINIGUI_RES
	bool "MiniGUI Resource (8.7 MB)"
	select BR2_PACKAGE_MINIGUI
	help
          http://www.minigui.org
```

## package/minigui/Config.in
```kconfig
config BR2_PACKAGE_MINIGUI
	bool "Minigui"
	select BR2_PACKAGE_JPEG
	select BR2_PACKAGE_LIBPNG
	select BR2_PACKAGE_FREETYPE
    select BR2_PACKAGE_HARFBUZZ
    select BR2_PACKAGE_PIXMAN
    select BR2_PACKAGE_LIBDRM
	help
          http://www.minigui.org
```

## package/python-pycairo/Config.in
```kconfig
config BR2_PACKAGE_PYTHON_PYCAIRO
	bool "python-pycairo"
	select BR2_PACKAGE_HICAIRO
	help
	  Python interface for cairo.

	  https://pycairo.readthedocs.io
```
